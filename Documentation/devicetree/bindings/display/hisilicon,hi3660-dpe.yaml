## Documentation/devicetree/bindings/display/hisilicon,hi3660-dpe.yaml
```yaml
# SPDX-License-Identifier: GPL-2.0
%YAML 1.2
---
$id: http://devicetree.org/schemas/display/hisilicon,hi3660-dpe.yaml#
$schema: http://devicetree.org/meta-schemas/core.yaml#

title: HiSilicon SPMI controller

maintainers:
  - Mauro Carvalho Chehab <mchehab+huawei@kernel.org>

description: |
  The HiSilicon Display Engine (DPE) is the display controller which grab
  image data from memory, do composition, do post image processing,
  generate RGB timing stream and transfer to DSI.

properties:
  $nodename:
    pattern: "dpe@[0-9a-f]+"

  compatible:
    enum:
      - hisilicon,hi3660-dpe
      - hisilicon,hi3670-dpe

  reg:
    maxItems: 7

  interrupts:
    maxItems: 1

  clocks:
    minItems: 7
    maxItems: 8
    description: Clocks used by the display engine.
    items:
      - description: aclk gate for DSS
      - description: pclk gate for DSS
      - description: clock divider for LDI0
      - description: clock divider for LDI1
      - description: clock gate for mmbuf
      - description: pclk gate for mmbuf
      - description: pclk gate for pctrl

  clock-names:
    minItems: 7
    maxItems: 8
    description: Names for the clock lines.
    items:
      - const: aclk_dss
      - const: pclk_dss
      - const: clk_edc0
      - const: clk_ldi0
      - const: clk_dss_axi_mm
      - const: pclk_mmbuf
      - const: pclk_pctrl
      - const: clk_ldi1

  dma-coherent: true

  port:
    type: object
    description: A port node pointing to the display output endpoint.

  iommu-info:
    type: object
    description: IOMMU address and size to be used by GPU

    properties:
      start-addr:
        const: start address for IOMMU
      size:
        const: size of the mapped region

additionalProperties: false

required:
  - compatible
  - reg
  - interrupts
  - clocks
  - clock-names
  - dma-coherent
  - port

examples:
  - |
    #include <dt-bindings/clock/hi3670-clock.h>

    bus {
      #address-cells = <2>;
      #size-cells = <2>;

      dpe: dpe@e8600000 {
        compatible = "hisilicon,hi3670-dpe";
        reg = <0 0xE8600000 0 0xC0000>,
              <0 0xFFF35000 0 0x1000>,
              <0 0xFFF0A000 0 0x1000>,
              <0 0xE8A09000 0 0x1000>,
              <0 0xE86C0000 0 0x10000>,
              <0 0xFFF31000 0 0x1000>,
              <0 0xE87FF000 0 0x1000>;

        interrupts = <0 245 4>;

        clocks = <&media1_crg HI3670_ACLK_GATE_DSS>,
                 <&media1_crg HI3670_PCLK_GATE_DSS>,
                 <&media1_crg HI3670_CLK_GATE_EDC0>,
                 <&media1_crg HI3670_CLK_GATE_LDI0>,
                 <&media1_crg HI3670_CLK_GATE_DSS_AXI_MM>,
                 <&media1_crg HI3670_PCLK_GATE_MMBUF>,
                 <&crg_ctrl   HI3670_PCLK_GATE_PCTRL>;

        clock-names = "aclk_dss",
                      "pclk_dss",
                      "clk_edc0",
                      "clk_ldi0",
                      "clk_dss_axi_mm",
                      "pclk_mmbuf",
                      "pclk_pctrl";

        dma-coherent;

        port {
          dpe_out: endpoint {
            remote-endpoint = <&dsi_in>;
          };
        };
      };
    };

...
```

## Documentation/devicetree/bindings/display/hisilicon,hi3660-dsi.yaml
```yaml
# SPDX-License-Identifier: GPL-2.0
%YAML 1.2
---
$id: http://devicetree.org/schemas/display/hisilicon,hi3660-dsi.yaml#
$schema: http://devicetree.org/meta-schemas/core.yaml#

title: HiSilicon SPMI controller

maintainers:
  - Mauro Carvalho Chehab <mchehab+huawei@kernel.org>

description: |
  The HiSilicon Display Serial Interface (DSI) Host Controller for
  Kirin 960 and 970 resides in the middle of display controller and
  an external HDMI converter or panel.

properties:
  compatible:
    enum:
      - hisilicon,hi3660-dsi
      - hisilicon,hi3670-dsi

  reg:
    minItems: 1
    maxItems: 4

  clocks:
    maxItems: 6
    description: |
      Clocks used by the ISP and by the display serial interface.
    items:
      - description: clock gate reference for TX dphy0
      - description: clock gate reference for TX dphy1
      - description: clock gate config for TX dphy0
      - description: clock gate config for TX dphy0
      - description: pclk gate for dsi0
      - description: pclk gate for dsi1

  clock-names:
    maxItems: 6
    description: Names for the clock lines.
    items:
      - const: clk_txdphy0_ref
      - const: clk_txdphy1_ref
      - const: clk_txdphy0_cfg
      - const: clk_txdphy1_cfg
      - const: pclk_dsi0
      - const: pclk_dsi1

  "#address-cells":
    const: 1

  "#size-cells":
    const: 0

  mux-gpio:
    description: GPIO used by the mux.

  ports:
    type: object
    description: Display input and output ports.

additionalProperties: false

required:
  - compatible
  - reg
  - clocks
  - clock-names
  - mux-gpio
  - ports

examples:
  - |
    #include <dt-bindings/clock/hi3670-clock.h>

    bus {
      #address-cells = <2>;
      #size-cells = <2>;

      dsi: dsi@e8601000 {
        compatible = "hisilicon,hi3670-dsi";
        reg = <0 0xE8601000 0 0x7F000>,
              <0 0xFFF35000 0 0x1000>,
              <0 0xE8A09000 0 0x1000>;

      clocks = <&crg_ctrl HI3670_CLK_GATE_TXDPHY0_REF>,
               <&crg_ctrl HI3670_CLK_GATE_TXDPHY1_REF>,
               <&crg_ctrl HI3670_CLK_GATE_TXDPHY0_CFG>,
               <&crg_ctrl HI3670_CLK_GATE_TXDPHY1_CFG>,
               <&crg_ctrl HI3670_PCLK_GATE_DSI0>,
               <&crg_ctrl HI3670_PCLK_GATE_DSI1>;

      clock-names = "clk_txdphy0_ref",
                    "clk_txdphy1_ref",
                    "clk_txdphy0_cfg",
                    "clk_txdphy1_cfg",
                    "pclk_dsi0",
                    "pclk_dsi1";

        #address-cells = <1>;
        #size-cells = <0>;
        mux-gpio = <&gpio25 7 0>;

        ports {
          #address-cells = <1>;
          #size-cells = <0>;

          port@0 {
            reg = <0>;
            dsi_in: endpoint {
              remote-endpoint = <&dpe_out>;
            };
          };

          port@1 {
            #address-cells = <1>;
            #size-cells = <0>;
            reg = <1>;

            dsi_out0: endpoint@0 {
              reg = <0>;
              remote-endpoint = <&adv7533_in>;
            };

            dsi_out1: endpoint@1 {
              reg = <1>;
              remote-endpoint = <&panel0_in>;
            };
          };
        };
      };
    };

...
```

## Documentation/devicetree/bindings/dma/hisilicon,hisi_dma_64.yaml
```yaml
# SPDX-License-Identifier: GPL-2.0
%YAML 1.2
---
$id: http://devicetree.org/schemas/dma/hisilicon,hisi_dma_64.yaml#
$schema: http://devicetree.org/meta-schemas/core.yaml#

title: Hisilicon Kirin 64 DMA Controller Device Tree Bindings

maintainers:
  - Mauro Carvalho Chehab <mchehab+huawei@kernel.org>

allOf:
  - $ref: "dma-controller.yaml#"

properties:
  "#dma-cells":
    description: The cell is the request line number.

  compatible:
    const: hisilicon,hisi-dma64-1.0

  reg:
    maxItems: 1

  interrupts:
    maxItems: 1

  clocks:
    minItems: 1
    maxItems: 2

  clock-names:
    items:
      - const: bus
      - const: mbus

required:
  - "#dma-cells"
  - compatible
  - reg
  - interrupts
  - clocks
  - resets
  - dma-channels

examples:
  - |
    dma0: dma@fdf30000 {
      compatible = "hisilicon,hisi-dma64-1.0";
      reg = <0x0 0xfdf30000 0x0 0x1000>;
      #dma-cells = <1>;
      dma-channels = <16>;
      dma-requests = <32>;
      dma-min-chan = <1>;
      interrupts = <0 143 4>;
      clocks = <&crg_ctrl HI3670_CLK_GATE_DMAC>,
         <&crg_ctrl HI3670_PCLK>;
      clock-names = "clk_dmac", "apb_pclk";
      status = "ok";
    };
```

## Documentation/devicetree/bindings/iommu/hisilicon,kirin36x0-smmu.yaml
```yaml
# SPDX-License-Identifier: GPL-2.0
%YAML 1.2
---
$id: http://devicetree.org/schemas/iommu/hisilicon,kirin36x0-smmu.yaml#
$schema: http://devicetree.org/meta-schemas/core.yaml#

title: Hisilicon support for HI3660/HI3670 SMMU

maintainers:
  - Mauro Carvalho Chehab <mchehab+huawei@kernel.org>

description: |+
  Huawei's Hisilicon Kirin 3660/3670 contains a System MMU that enables
  scattered physical memory chunks visible as a contiguous region to
  DMA-capable peripheral devices like GPU and ISP.

  The IOMMU domains are described via iommu_info settings.

properties:
  compatible:
    const: hisilicon,hisi-smmu-lpae

  iommu_info:
    type: object

    properties:
      start-addr:
        maxItems: 1
        description: Memory start address (32 bits)

      size:
        maxItems: 1
        description: size of the I/O MMU block (32 bits)

      iova-align:
        minItems: 2
        maxItems: 2
        description: DMA address alignment of the mapped memory (64 bits)

required:
  - compatible

additionalProperties: false

examples:
  - |
    smmu_lpae {
      compatible = "hisilicon,smmu-lpae";

      iommu_info {
        start-addr = <0x40000>;
        size = <0xbffc0000>;
        iova-align = <0x0 0x8000>;
      };
    };
```

## Documentation/devicetree/bindings/pci/designware,pcie.yaml
```yaml
# SPDX-License-Identifier: GPL-2.0
%YAML 1.2
---
$id: http://devicetree.org/schemas/pci/designware,pcie.yaml#
$schema: http://devicetree.org/meta-schemas/core.yaml#

title: Synopsys DesignWare PCIe interface

maintainers:
  - Jingoo Han <jingoohan1@gmail.com>
  - Gustavo Pimentel <gustavo.pimentel@synopsys.com>

description: |
  Synopsys DesignWare PCIe host controller

properties:
  compatible:
    description: |
      The compatible can be either:
      - snps,dw-pcie       # for RC mode
      - snps,dw-pcie-ep    # For EP mode
      or some other value, when there's a host-specific driver

  reg:
    description: |
      For designware cores version < 4.80 contains the configuration
      address space. For designware core version >= 4.80, contains
      the configuration and ATU address space
    maxItems: 4

  reg-names:
    description: |
      Must be "config" for the PCIe configuration space and "atu" for
      the ATU address space.
      (The old way of getting the configuration address space from
      "ranges" is deprecated and should be avoided.)
    maxItems: 4

  num-lanes:
    description: |
      number of lanes to use (this property should be specified unless
      the link is brought already up in BIOS)
    maxItems: 1

  reset-gpio:
    description: GPIO pin number of power good signal
    maxItems: 1

  clocks:
    description: |
      Must contain an entry for each entry in clock-names.
      See Documentation/devicetree/bindings/clock/clock-bindings.txt for
      details.
    minItems: 2
    maxItems: 8

  clock-names:
    description: |
      Must include the following entries:
      - "pcie"
      - "pcie_bus"
    minItems: 2
    maxItems: 8

  "snps,enable-cdm-check":
    $ref: /schemas/types.yaml#definitions/flag
    description: |
      This is a boolean property and if present enables
      automatic checking of CDM (Configuration Dependent Module) registers
      for data corruption. CDM registers include standard PCIe configuration
      space registers, Port Logic registers, DMA and iATU (internal Address
      Translation Unit) registers.

  # The following are mandatory properties for RC Mode

  "#address-cells":
    const: 3

  "#size-cells":
    const: 2

  device_type:
    const: pci

  ranges:
    $ref: /schemas/types.yaml#/definitions/uint32-array
    description: |
      ranges for the PCI memory and I/O regions
    minItems: 1
    maxItems: 8

  "#interrupt-cells":
    $ref: /schemas/types.yaml#/definitions/uint32
    const: 1

  interrupt-map-mask:
    description: |
      Standard PCI properties to define the mapping of the PCIe
      interface to interrupt numbers.

  interrupt-map:
    description: |
      Standard PCI properties to define the mapping of the PCIe
      interface to interrupt numbers.

  # The following are optional properties for RC mode

  num-viewport:
    description: |
      number of view ports configured in hardware. If a platform
      does not specify it, the driver assumes 2.

  bus-range:
    description: |
      PCI bus numbers covered (it is recommended for new devicetrees
      to specify this property, to keep backwards compatibility a range of
      0x00-0xff is assumed if not present)

  # The following are mandatory properties for EP Mode

  num-ib-windows:
    description: number of inbound address translation windows
    maxItems: 1

  num-ob-windows:
    description: number of outbound address translation windows
    maxItems: 1

  # The following are optional properties for EP mode

  max-functions:
    description: maximum number of functions that can be configured
    maxItems: 1

required:
  - reg
  - reg-names
  - compatible

allOf:
  - if:
      properties:
        compatible:
          contains:
            const: snps,dw-pcie
    then:
      allOf:
        - $ref: /schemas/pci/pci-bus.yaml#
        - required:
            - compatible
            - "#address-cells"
            - "#size-cells"
            - device_type
            - ranges
            - "#interrupt-cells"
            - interrupt-map-mask
            - interrupt-map
  - if:
      properties:
        compatible:
          contains:
            const: snps,dw-pcie-ep
    then:
      required:
        - compatible
        - num-ib-windows
        - num-ob-windows

additionalProperties: false

examples:
  - |
    pcie: pcie@dfc00000 {
      compatible = "snps,dw-pcie";
      reg = <0xdfc00000 0x0001000>, /* IP registers */
            <0xd0000000 0x0002000>; /* Configuration space */
      reg-names = "dbi", "config";
      #address-cells = <3>;
      #size-cells = <2>;
      device_type = "pci";
      ranges = <0x81000000 0 0x00000000 0xde000000 0 0x00010000>,
               <0x82000000 0 0xd0400000 0xd0400000 0 0x0d000000>;
      interrupts = <25>, <24>;
      #interrupt-cells = <1>;
      num-lanes = <1>;
    };
    pcie_ep: pcie_ep@dfd00000 {
      compatible = "snps,dw-pcie-ep";
      reg = <0xdfc00000 0x0001000>, /* IP registers 1 */
            <0xdfc01000 0x0001000>, /* IP registers 2 */
            <0xd0000000 0x2000000>; /* Configuration space */
      reg-names = "dbi", "dbi2", "addr_space";
      num-ib-windows = <6>;
      num-ob-windows = <2>;
      num-lanes = <1>;
    };
```

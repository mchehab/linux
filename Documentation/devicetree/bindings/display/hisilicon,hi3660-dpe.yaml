## Documentation/devicetree/bindings/pci/hisilicon,kirin-pcie.yaml
```yaml
# SPDX-License-Identifier: GPL-2.0
%YAML 1.2
---
$id: http://devicetree.org/schemas/pci/hisilicon,kirin-pcie.yaml#
$schema: http://devicetree.org/meta-schemas/core.yaml#

title: HiSilicon Kirin SoCs PCIe host DT description

maintainers:
  - Xiaowei Song <songxiaowei@hisilicon.com>
  - Binghui Wang <wangbinghui@hisilicon.com>

description: |
  Kirin PCIe host controller is based on the Synopsys DesignWare PCI core.
  It shares common functions with the PCIe DesignWare core driver and
  inherits common properties defined in
  Documentation/devicetree/bindings/pci/snps,dw-pcie.yaml.

allOf:
  - $ref: /schemas/pci/snps,dw-pcie.yaml#

properties:
  compatible:
    contains:
      enum:
        - hisilicon,kirin960-pcie
        - hisilicon,kirin970-pcie

  reg:
    description: |
      Should contain rc_dbi, apb, config registers location and length.
    minItems: 3
    maxItems: 4

  reg-names:
    items:
      - const: dbi          # controller configuration registers
      - const: apb          # apb Ctrl register defined by Kirin
      - const: config       # PCIe configuration space registers
      - const: phy          # apb PHY register used on Kirin 960 PHY
    minItems: 3
    maxItems: 4

  reset-gpios:
    description: The GPIO(s) to generate PCIe PERST# assert and deassert signal.
    minItems: 1
    maxItems: 4

required:
  - compatible
  - reg
  - reg-names

unevaluatedProperties: false

examples:
  - |
    #include <dt-bindings/interrupt-controller/arm-gic.h>

    soc {
      #address-cells = <2>;
      #size-cells = <2>;

      pcie: pcie@f4000000 {
        compatible = "hisilicon,kirin970-pcie";
        reg = <0x0 0xf4000000 0x0 0x1000>,
              <0x0 0xff3fe000 0x0 0x1000>,
              <0x0 0xf4000000 0 0x2000>;
        reg-names = "dbi", "apb", "config";
        bus-range = <0x0  0x1>;
        #address-cells = <3>;
        #size-cells = <2>;
        device_type = "pci";
        ranges = <0x02000000 0x0 0x00000000 0x0 0xf5000000 0x0 0x2000000>;
        num-lanes = <1>;
        #interrupt-cells = <1>;
        interrupts = <0 283 4>;
        interrupt-names = "msi";
        interrupt-map-mask = <0xf800 0 0 7>;
        interrupt-map = <0x0 0 0 1 &gic GIC_SPI 282 IRQ_TYPE_LEVEL_HIGH>,
                        <0x0 0 0 2 &gic GIC_SPI 283 IRQ_TYPE_LEVEL_HIGH>,
                        <0x0 0 0 3 &gic GIC_SPI 284 IRQ_TYPE_LEVEL_HIGH>,
                        <0x0 0 0 4 &gic GIC_SPI 285 IRQ_TYPE_LEVEL_HIGH>;
        reset-gpios = <&gpio7 0 0 >, <&gpio25 2 0 >,
                      <&gpio3 1 0 >, <&gpio27 4 0 >;
      };
    };
```

## Documentation/devicetree/bindings/pci/snps,pcie.yaml
```yaml
# SPDX-License-Identifier: GPL-2.0
%YAML 1.2
---
$id: http://devicetree.org/schemas/pci/snps,pcie.yaml#
$schema: http://devicetree.org/meta-schemas/core.yaml#

title: Synopsys DesignWare PCIe interface

maintainers:
  - Jingoo Han <jingoohan1@gmail.com>
  - Gustavo Pimentel <gustavo.pimentel@synopsys.com>

description: |
  Synopsys DesignWare PCIe host controller

anyOf:
  - {}
  - items:
      contains:
        enum:
          - snps,dw-pcie
          - snps,dw-pcie-ep

properties:
  compatible:
    description: |
      The compatible can be either:
      - snps,dw-pcie       # for RC mode
      - snps,dw-pcie-ep    # For EP mode
      or some other value, when there's a host-specific driver

  reg:
    description: |
      Contains DBI and the configuration address space for all
      Designware versions.
      For Designware core version >= 4.80, should also contain the
      ATU address space.
    minItems: 2
    maxItems: 4

  reset-gpio:
    description: GPIO pin number for the PERST# signal
    maxItems: 1

  clocks:
    minItems: 2
    maxItems: 8

  clock-names:
    items:
      contains:
        enum: [ pcie, pcie_bus ]
    minItems: 2
    maxItems: 8

  "snps,enable-cdm-check":
    $ref: /schemas/types.yaml#definitions/flag
    description: |
      This is a boolean property and if present enables
      automatic checking of CDM (Configuration Dependent Module) registers
      for data corruption. CDM registers include standard PCIe configuration
      space registers, Port Logic registers, DMA and iATU (internal Address
      Translation Unit) registers.

  # The following are optional properties for RC mode

  num-viewport:
    description: |
      number of view ports configured in hardware. If a platform
      does not specify it, the driver assumes 2.
    deprecated: true

  # The following are mandatory properties for EP Mode

  num-ib-windows:
    description: number of inbound address translation windows
    maxItems: 1
    deprecated: true

  num-ob-windows:
    description: number of outbound address translation windows
    maxItems: 1
    deprecated: true

  # The following are optional properties for EP mode

  max-functions:
    description: maximum number of functions that can be configured

required:
  - reg
  - reg-names

allOf:
  - if:
      properties:
        compatible:
          contains:
            const: snps,dw-pcie
    then:
      allOf:
        - $ref: /schemas/pci/pci-bus.yaml#
  - if:
      properties:
        compatible:
          contains:
            const: snps,dw-pcie-ep
    then:
      required:
        - compatible

additionalProperties: false

examples:
  - |
    pcie: pcie@dfc00000 {
      compatible = "snps,dw-pcie";
      reg = <0xdfc00000 0x0001000>, /* IP registers */
            <0xd0000000 0x0002000>; /* Configuration space */
      reg-names = "dbi", "config";
      #address-cells = <3>;
      #size-cells = <2>;
      device_type = "pci";
      ranges = <0x81000000 0 0x00000000 0xde000000 0 0x00010000>,
               <0x82000000 0 0xd0400000 0xd0400000 0 0x0d000000>;
      interrupts = <25>, <24>;
      #interrupt-cells = <1>;
      num-lanes = <1>;
    };
    pcie_ep: pcie_ep@dfd00000 {
      compatible = "snps,dw-pcie-ep";
      reg = <0xdfc00000 0x0001000>, /* IP registers 1 */
            <0xdfc01000 0x0001000>, /* IP registers 2 */
            <0xd0000000 0x2000000>; /* Configuration space */
      reg-names = "dbi", "dbi2", "addr_space";
      num-ib-windows = <6>;
      num-ob-windows = <2>;
      num-lanes = <1>;
    };
```

## Documentation/devicetree/bindings/spmi/hisilicon,hisi-spmi-controller.yaml
```yaml
# SPDX-License-Identifier: GPL-2.0
%YAML 1.2
---
$id: http://devicetree.org/schemas/spmi/hisilicon,hisi-spmi-controller.yaml#
$schema: http://devicetree.org/meta-schemas/core.yaml#

title: HiSilicon SPMI controller

maintainers:
  - Mauro Carvalho Chehab <mchehab+huawei@kernel.org>

description: |
  The HiSilicon SPMI controller is found on some Kirin-based designs.
  It is a MIPI System Power Management (SPMI) controller.

  The PMIC part is provided by
  Documentation/devicetree/bindings/mfd/hisilicon,hi6421-spmi-pmic.yaml.

properties:
  $nodename:
    pattern: "spmi@[0-9a-f]"

  compatible:
    const: hisilicon,spmi-controller

  reg:
    maxItems: 1

  "#address-cells":
    const: 2

  "#size-cells":
    const: 0

  spmi-channel:
    const: number of the SPMI channel where the PMIC is connected

patternProperties:
  "^pmic@[0-9a-f]$":
    $ref: "/schemas/mfd/hisilicon,hi6421-spmi-pmic.yaml#"

examples:
  - |
    spmi: spmi@fff24000 {
      compatible = "hisilicon,spmi-controller";
      #address-cells = <2>;
      #size-cells = <0>;
      status = "ok";
      reg = <0x0 0xfff24000 0x0 0x1000>;
      spmi-channel = <2>;

      /* pmic properties */

    };
```

## drivers/gpu/drm/hisilicon/Kconfig
```kconfig
# SPDX-License-Identifier: GPL-2.0-only
#
# hisilicon drm device configuration.
# Please keep this list sorted alphabetically

config DRM_HISI_KIRIN
	bool "DRM Support for Hisilicon SoCs Platform"
	depends on DRM && OF && ARM64
	select DRM_KMS_HELPER
	select DRM_GEM_CMA_HELPER
	select DRM_KMS_CMA_HELPER
	select HISI_KIRIN_DW_DSI
	help
	  Choose this option if you have a Hisilicon chipset.

if DRM_HISI_KIRIN
source "drivers/gpu/drm/hisilicon/hibmc/Kconfig"
source "drivers/gpu/drm/hisilicon/kirin/Kconfig"
endif
```

## drivers/gpu/drm/hisilicon/kirin/Kconfig
```kconfig
# SPDX-License-Identifier: GPL-2.0-only
config DRM_HISI_KIRIN6220
	tristate "DRM Support for Hisilicon Kirin 6220 series SoCs Platform"
	depends on DRM && OF && ARM64
	select DRM_KMS_HELPER
	select DRM_GEM_CMA_HELPER
	select DRM_KMS_CMA_HELPER
	select DRM_MIPI_DSI
	help
	  Choose this option if you have a hisilicon Kirin chipsets(hi6220).
	  If M is selected the module will be called kirin-drm.

config DRM_HISI_KIRIN9XX
	tristate "DRM Support for Hisilicon Kirin9xx series SoCs Platform"
	depends on DRM && OF && ARM64
	select DRM_KMS_HELPER
	select DRM_GEM_CMA_HELPER
	select DRM_KMS_CMA_HELPER
	select DRM_MIPI_DSI
	help
	  Choose this option if you have a hisilicon Kirin960 or Kirin970.
	  If M is selected the module will be called kirin9xx-drm.

config DRM_HISI_KIRIN_DSI
	tristate
	depends on DRM_HISI_KIRIN6220
	default y

config DRM_HISI_KIRIN9XX_DSI
	tristate
	depends on DRM_HISI_KIRIN9XX
	default y
```

## drivers/staging/hikey9xx/Kconfig
```kconfig
# SPDX-License-Identifier: GPL-2.0

# DRM/KMS driver
source "drivers/staging/hikey9xx/gpu/Kconfig"
```

## drivers/staging/hikey9xx/gpu/Kconfig
```kconfig
config DRM_HISI_KIRIN9XX
	tristate "DRM Support for Hisilicon Kirin9xx series SoCs Platform"
	depends on DRM && OF && ARM64
	select DRM_KMS_HELPER
	select DRM_GEM_CMA_HELPER
	select DRM_KMS_CMA_HELPER
	select DRM_MIPI_DSI
	help
	  Choose this option if you have a HiSilicon Kirin960 or Kirin970.
	  If M is selected the module will be called kirin9xx-drm.
```
